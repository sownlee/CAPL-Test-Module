/*@!Encoding:1252*/
includes
{
  
}

variables
{
  //Body::BCM::BCM_RemoteKey::BCM_Key_CheckSts
  msTimer Timer_delay;
  msTimer Timer_BCM;
  //Message BCM_RemoteKey BCM_Key_CheckSts;
  Message 0x681 msg_tx;
  Message 0x601 msg_rx;
  
}

on start{}

on timer Timer_delay{}

on timer Timer_BCM{}
on key 'a'
{
  cancelTimer(Timer_BCM);
}

on key 'd'
{
  msg_tx.dlc = 8;
  msg_tx.byte(0) = 0x03; // SF, length = 3
  msg_tx.byte(1) = 0x22; // SID: ReadDataByIdentifier
  msg_tx.byte(2) = 0xF1; // DID High
  msg_tx.byte(3) = 0x90; // DID Low (=> DID 0x0619)
  msg_tx.byte(4) = 0x00;
  msg_tx.byte(5) = 0x00;
  msg_tx.byte(6) = 0x00;
  msg_tx.byte(7) = 0x00;
  output(msg_tx); 
  write("Sent RDBI DID 0xF190");
}

on message 0x601
{
 // In ra hex d? d? debug
  write("Rx: %02X %02X %02X %02X %02X %02X %02X %02X", 
        msg_rx.byte(0), msg_rx.byte(1), msg_rx.byte(2), msg_rx.byte(3),
        msg_rx.byte(4), msg_rx.byte(5), msg_rx.byte(6), msg_rx.byte(7));
 // check_byte0 = this.byte(0) & 0x30;
 // Ki?m tra First Frame (FF)
  msg_rx = this;
  if((msg_rx.byte(0) & 0xF0) == 0x10)  // 16 decimal = 0x10 hex
  {
  msg_tx.dlc = 8;
  msg_tx.byte(0) = 0x30; // SF, length = 3
  msg_tx.byte(1) = 0x00; // SID: ReadDataByIdentifier
  msg_tx.byte(2) = 0x00; // DID High
  msg_tx.byte(3) = 0x00; // DID Low (=> DID 0x0619)
  msg_tx.byte(4) = 0x00;
  msg_tx.byte(5) = 0x00;
  msg_tx.byte(6) = 0x00;
  msg_tx.byte(7) = 0x00;
  output(msg_tx);
  }
}