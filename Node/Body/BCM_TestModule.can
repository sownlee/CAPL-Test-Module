/*@!Encoding:1252*/
// File: TC01_BCM_Basic_Lock_Unlock.can
// Test Case 01: BCM Central Locking - Basic Lock & Unlock
// Dùng dúng signal th?t trong VF5 Body CAN Matrix V9.1.0

on start {
    setTestGroup("TC01 - BCM Basic Lock/Unlock");
    TC01_BasicLockUnlock();
    write("=== TC01 Completed ===");
}

testcase TC01_BasicLockUnlock() {
    testStep("TC01 - BCM Basic Lock/Unlock Test");

    // Bu?c 1: G?i l?nh khóa c?a (Remote Lock)
    GW_MHU_BCM_DoorsCtrl_0x10D.MHU_BCM_RemoteDoorCtrl = 1;   // 1 = Lock
    output(create(0x10D));
    testWaitForTimeout(1000);   // Ð?i BCM x? lý

    // Ki?m tra tr?ng thái khóa c?a (4 c?a d?u ph?i = 1: Locked)
    if (BCM_STAT_CENTRAL_LOCK_0x107.STAT_DoorLockDriver      != 1 ||
        BCM_STAT_CENTRAL_LOCK_0x107.STAT_DoorLockPassenger  != 1 ||
        BCM_STAT_CENTRAL_LOCK_0x107.STAT_DoorLockRL         != 1 ||
        BCM_STAT_CENTRAL_LOCK_0x107.STAT_DoorLockRR         != 1) {
        testStepFail("LOCK FAILED - Not all doors are locked!");
        return;
    }
    testStep("All doors LOCKED successfully");

    // Bu?c 2: G?i l?nh m? khóa (Remote Unlock)
    GW_MHU_BCM_DoorsCtrl_0x10D.MHU_BCM_RemoteDoorCtrl = 2;   // 2 = Unlock
    output(create(0x10D));
    testWaitForTimeout(1000);

    // Ki?m tra tr?ng thái m? khóa (4 c?a d?u ph?i = 0: Unlocked)
    if (BCM_STAT_CENTRAL_LOCK_0x107.STAT_DoorLockDriver      != 0 ||
        BCM_STAT_CENTRAL_LOCK_0x107.STAT_DoorLockPassenger  != 0 ||
        BCM_STAT_CENTRAL_LOCK_0x107.STAT_DoorLockRL         != 0 ||
        BCM_STAT_CENTRAL_LOCK_0x107.STAT_DoorLockRR         != 0) {
        testStepFail("UNLOCK FAILED - Not all doors are unlocked!");
        return;
    }

    testStepPass("TC01 - Basic Lock & Unlock PASSED perfectly!");
}