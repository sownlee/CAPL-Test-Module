/*@!Encoding:1252*/
// TC01_BCM_Basic_LockUnlock.can
// Test Module CAPL - Ch?y du?c ngay trong Test Environment
// Dùng dúng signal th?t c?a VF5 Body CAN Matrix V9.1.0

variables
{
    message 0x10D msg10D;      // GW_MHU_BCM_DoorsCtrl_0x10D
    message 0x107 msg107;      // BCM_STAT_CENTRAL_LOCK_0x107
}

// Ðây là entry point dúng c?a Test Module (không dùng on start)
on startMeasurement
{
    setTestCaseTitle("TC01 - BCM Basic Lock & Unlock");
    TC01_BasicLockUnlock();
}

// Test case chính
testcase TC01_BasicLockUnlock()
{
    testStep("B?t d?u ki?m tra Lock ? Unlock co b?n");

    // === B1: G?i l?nh KHÓA C?A ===
    msg10D.byte(0) = 1;                         // MHU_BCM_RemoteDoorCtrl = 1 (Lock)
    output(msg10D);
    testWaitForTimeout(1000);

    // Ki?m tra BCM ph?n h?i t?t c? c?a d?u khóa
    if (msg107.byte(0) != 1 ||   // STAT_DoorLockDriver
        msg107.byte(1) != 1 ||   // STAT_DoorLockPassenger
        msg107.byte(2) != 1 ||   // STAT_DoorLockRL
        msg107.byte(3) != 1)     // STAT_DoorLockRR
    {
        testStepFail("LOCK FAILED - M?t ho?c nhi?u c?a chua khóa!");
        return;
    }
    testStep("T?t c? c?a dã KHÓA thành công");

    // === B2: G?i l?nh M? KHÓA ===
    msg10D.byte(0) = 2;                         // MHU_BCM_RemoteDoorCtrl = 2 (Unlock)
    output(msg10D);
    testWaitForTimeout(1000);

    // Ki?m tra t?t c? c?a m? khóa
    if (msg107.byte(0) != 0 ||
        msg107.byte(1) != 0 ||
        msg107.byte(2) != 0 ||
        msg107.byte(3) != 0)
    {
        testStepFail("UNLOCK FAILED - M?t ho?c nhi?u c?a chua m? khóa!");
        return;
    }

    testStepPass("TC01 PASSED - Lock & Unlock ho?t d?ng hoàn h?o!");
}