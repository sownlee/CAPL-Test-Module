/*@!Encoding:1252*/

variables
{
    message GW_BCM_CLAMP_STAT_0x112 STAT_Terminal; 
    message GW_BCM_DoorSts_0x3D0 STAT_DoorLockDriver;
    message GW_ABS_WheelSpdR_0x342 ABS_VehSpd; 

    msTimer msTimer_EngineStatus; 
}

on start
{
    setTimerCyclic(msTimer_EngineStatus, 100); // Set the timer to trigger every 100 milliseconds
}

on timer msTimer_EngineStatus
{
    // Access system variables directly using the correct syntax
    ABS_VehSpd.ABS_VehSpd = @testNS::Velocity; // Access system variable for velocity
    STAT_Terminal.STAT_Terminal = @testNS::IgnitionStart; // Access system variable for ignition state

    output(ABS_VehSpd); // Output the ABS_VehSpd message onto the CAN bus
    output(STAT_Terminal); // Output the STAT_Terminal message onto the CAN bus
}
