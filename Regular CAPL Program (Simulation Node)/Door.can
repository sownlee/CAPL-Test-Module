/*@!Encoding:1252*/
includes
{
    // Khai báo các thu vi?n c?n thi?t (n?u có)
}

variables
{
    int vehicleSpeed;
    byte IgnitionState;
    byte WindowState = 0;
    
    message GW_BCM_DoorSts_0x3D0 BCM_STAT_DriverDoor;  
    message GW_BCM_DoorSts_0x3D0 STAT_DoorLockDriver;
    message GW_ABS_WheelSpdR_0x342 ABS_VehSpd;
}

on message GW_ABS_WheelSpdR_0x342
{
    vehicleSpeed = this.ABS_VehSpd; // status signal ABS_VehSpd
}

on message GW_BCM_CLAMP_STAT_0x112
{ 
    // save status Ignition
    if(this.STAT_Terminal)
        IgnitionState = 1; // Ignition is On
    else
        IgnitionState = 0; // Ignition is Off
}

on message GW_BCM_DoorSts_0x3D0
{
    // check lock door driver
    if (IgnitionState == 1 && vehicleSpeed > 15)
    {
        this.STAT_DoorLockDriver = 1; // Set State to "Lock"
        output(this); // send message updated
    }
}
